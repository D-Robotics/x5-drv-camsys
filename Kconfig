## Kconfig
```kconfig
#
# VIO configuration
#

menu "VIO Configuratio"
config HOBOT_VIO
	tristate "HOBOT VIO Drivers"
	default n
	help
	   Drivers for the HOBOT VIO

config HOBOT_VIO_JPLUS
	 tristate "HOBOT VIO JPLUS Drivers"
	default n
	help
	   Drivers for the HOBOT VIO

config HOBOT_VIO_COMMON
         tristate "HOBOT VIO COMMON Drivers"
        default n
        help
           Drivers for the HOBOT VIO

config HOBOT_VIN_NODE
	 tristate "HOBOT VIN_NODE Drivers"
	default n
	help
	   Drivers for the HOBOT VIO

config HOBOT_VCON
	 tristate "HOBOT VCON Drivers"
	default n
	depends on HOBOT_VIN_NODE
	help
	   Drivers for the HOBOT VIO

config HOBOT_CAMSYS
         tristate "HOBOT CAMSYS Drivers"
        default n
        help
           Drivers for the HOBOT VIO

config HOBOT_GDC_JPLUS
	 tristate "HOBOT GDC JPLUS Drivers"
	default n
	help
	   Drivers for the HOBOT VIO

config HOBOT_SENSOR
	 tristate "HOBOT SENSOR Drivers"
	default n
	help
	   Drivers for the HOBOT Sensor Driver

config HOBOT_DESERIAL
	 tristate "HOBOT DESERIAL Drivers"
	default n
	help
	   Drivers for the HOBOT Deserial Driver

config HOBOT_LPWM
	tristate "HOBOT LPWM Drivers"
	default n
	depends on HOBOT_VIN_NODE
	help
	   Drivers for the HOBOT VIO

config HOBOT_VTRACE
	tristate "HOBOT VTRACE Drivers"
	default n
	help
	   Drivers for the HOBOT Vtrace Driver

config HOBOT_OSD
	tristate "HOBOT OSD Drivers"
	default n
	help
	   Drivers for the HOBOT OSD Driver

config HOBOT_VSI_CAM
	tristate "VSI CAM Drivers"
	default n
	help
	   Drivers for the Vsi Cam Driver

endmenu

config HOBOT_MIPI_CSI
	bool "Hobot MIPI CSI Drivers"
	depends on HOBOT_VIN_NODE
	help
	  Drivers for the Hobot MIPI CSI

config HOBOT_CODEC_NODE
	 tristate "HOBOT CODEC_NODE Drivers"
	default n
	help
	   Drivers for the HOBOT VIO

source "drivers/media/platform/horizon/camsys/mipi/Kconfig"
source "drivers/media/platform/horizon/camsys/idu/Kconfig"
source "drivers/media/platform/horizon/camsys/vsi_cam/Kconfig"
```

## idu/Kconfig
```kconfig
# HOBOT videoIDU configuration

config HOBOT_IDU_VNODE
       tristate "HOBOT videoIDU driver support"
       help
         If you have an videostitich devices
         say Y or M here, otherwise say N.

config VIDEOIDU_STL_J5
	tristate "Horizon J5 VIDEOIDU STL support"
	depends on HOBOT_J5_STL
	default n
	help
		If you say yes here, you get support for the J5 SoC
		videoIDU selftest.
```

## mipi/Kconfig
```kconfig
#
# hobot mipi configuration
#

config HOBOT_MIPI_CSI_DRV
    tristate "Hobot MIPI CSI Driver"
	depends on HOBOT_MIPI_CSI
	help
      Driver for the HOBOT VIN MIPI CSI


config HOBOT_MIPI_HOST
    bool "Hobot MIPI CSI Host Support"
	depends on HOBOT_MIPI_CSI_DRV
        default y
	help
      support for the HOBOT MIPI CSI Host

config HOBOT_MIPI_HOST_MAX_NUM
    int "Hobot MIPI host max port num"
	depends on HOBOT_MIPI_HOST
	default 4 if HOBOT_XJ3 || HOBOT_J5 || HOBOT_FPGA_J5 || ARCH_ZYNQMP
	default 3 if HOBOT_J6E || HOBOT_FPGA_J6E
	default 6 if HOBOT_J6P || HOBOT_FPGA_J6P
	default 1 if HOBOT_XJ2
	help
      Max num of mipi host devices

config HOBOT_MIPI_HOST_SNRCLK
    bool "Hobot MIPI host sensor mclk support"
	depends on HOBOT_MIPI_HOST
	default n
	help
      Enable mipi host support mclk output for sensor


config HOBOT_MIPI_DEV
    bool "Hobot MIPI CSI Device Support"
	depends on HOBOT_MIPI_CSI_DRV
        default y
	help
      support for the HOBOT MIPI CSI Device

config HOBOT_MIPI_DEV_MAX_NUM
    int "Hobot MIPI dev max port num"
	depends on HOBOT_MIPI_DEV
	default 2 if HOBOT_J5 || HOBOT_FPGA_J5 || ARCH_ZYNQMP
	default 2 if HOBOT_J6P || HOBOT_FPGA_J6P || HOBOT_J6E || HOBOT_FPGA_J6E
	default 1 if HOBOT_XJ2 || HOBOT_XJ3
	help
      Max num of mipi dev devices

config HOBOT_MIPI_PHY
    tristate "Hobot MIPI DPHY Driver"
	depends on HOBOT_MIPI_CSI || (HOBOT_XJ3 && HOBOT_IAR)
	help
      Driver for the HOBOT MIPI DPHY

config HOBOT_MIPI_REG_OPERATE
    bool "ENABLE REG IOCTL OPERATE"
    depends on HOBOT_MIPI_CSI
    default n
	help
      enable mipi devices' reg ioctl opreate

config HOBOT_MIPI_CSI_STL
	tristate "Hobot MIPI CSI STL Driver"
	depends on HOBOT_MIPI_CSI && HOBOT_FUSA_DIAG
	depends on HOBOT_J5_STL
	default n
	help
      Driver for the HOBOT MIPI CSI selftest

config HOBOT_MIPI_CSI_HOST_STL
	bool "Hobot MIPI CSI HOST STL support"
	depends on HOBOT_MIPI_CSI_STL
	default n
	help
      support for mipi csi host selftest

config HOBOT_MIPI_CSI_ERM_STL
	bool "Hobot MIPI CSI ERM STL support"
	depends on HOBOT_MIPI_CSI_STL
	default n
	help
      support for mipi csi erm selftest

config HOBOT_MIPI_DEBUG
	tristate "Hobot MIPI CSI DEBUG Driver"
	depends on HOBOT_MIPI_CSI
	default n
	help
      Driver for the HOBOT MIPI CSI debug
```

## vsi_cam/Kconfig
```kconfig
# SPDX-License-Identifier: GPL-2.0-only
if MEDIA_CAMERA_SUPPORT

config VIDEO_VS_ISP_NAT
	tristate "VeriSilicon ISP (NAT) support"
	depends on OF && HAS_DMA
	select VIDEO_VS_SW_ISC
	help
	  This is a driver that is complying with customers' native framework
	  for VeriSilicon's ISP series integrated processor. Basically, it
	  provides interfaces to configure hardware IP for VeriSilicon's camera
	  service and handles requests from the native framework.

config VIDEO_VS_VSE_NAT
	tristate "VeriSilicon VSE (NAT) support"
	depends on OF && HAS_DMA
	select VIDEO_VS_SW_ISC
	help
	  This is a driver that is complying with customers' native framework
	  for VeriSilicon's video scaling series integrated processor. Basically,
	  it provides interfaces to configure hardware IP for VeriSilicon's
	  camera service and handles requests from the native framework.

config VIDEO_VS_SIF_NAT
	tristate "VeriSilicon SIF (NAT) support"
	depends on OF && HAS_DMA && HOBOT_VIN_NODE
	select VIDEO_VS_CSI2_SNPS_NAT
	select VIDEO_VS_SW_ISC
	help
	  This is a driver that is complying with customers' native framework
	  for VeriSilicon's camera sensor interface integrated processor. It
	  contains the key configuration and executing logic for SIF hardware
	  IP.

config VIDEO_VS_CSI2_SNPS_NAT
	tristate "Synopsys CSI v2 (NAT) support"
	depends on OF && HAS_DMA
	select VIDEO_VS_CSI_WRAPPER
	select VIDEO_VS_CSI2_SNPS_NAT_HBN_ADPT
	default n
	help
	  This is a driver that is complying with customers' native framework
	  for Synopsys's MIPI CSI v2 integrated processor. It contains the key
	  configuration and executing logic for MIPI CSI v2 controller and
	  dphy in the hardware.

config VIDEO_VS_CSI2_SNPS_NAT_HBN_ADPT
	bool "Synopsys CSI v2 (NAT) HBN mipi host adapter"
	depends on VIDEO_VS_CSI2_SNPS_NAT
	default n
	help
	  This is a driver that is complying with customers' native framework
	  for Synopsys's MIPI CSI v2 integrated processor. It redirects the key
	  configuration and executing logic from customers' mipi host driver
	  to vs csi2 snps native driver.

config VIDEO_VS_CSI_WRAPPER
	tristate "VeriSilicon CSI Wrapper support"
	help
	  This is a driver that for VeriSilicon's CSI Rx system register control.

config VIDEO_VS_CAM_CTRL
	tristate "VeriSilicon Camera SYS Control support"
	help
	  This is a driver that for VeriSilicon's camera subsystem register control.

config VIDEO_VS_CAM_PULSE
	tristate "VeriSilicon Camera Pulse Generater Support"
	help
	  This is a driver that for VeriSilicon's camera subsystem pulse generater control.

config VIDEO_VS_SW_ISC
	bool "VeriSilicon Software Communication Support"
	default y
	depends on VIDEO_VS_ISP_NAT || VIDEO_VS_VSE_NAT || VIDEO_VS_SIF_NAT || \
	  VIDEO_VS_ISP_V4L || VIDEO_VS_VSE_V4L || VIDEO_VS_SIF_V4L
	help
	  This is a software driver that implements a general way for the
	  communication requirement between VeriSilicon's camera service
	  in the user space and camera related IP (or module) drivers in
	  the kernel space.

if V4L_PLATFORM_DRIVERS

config VIDEO_VS_ISP_V4L
	tristate "VeriSilicon ISP (V4L) support"
	depends on VIDEO_DEV && OF && HAS_DMA
	select VIDEOBUF2_DMA_CONTIG
	select V4L2_FWNODE
	select VIDEO_V4L2_SUBDEV_API
	select VIDEO_VS_VID_V4L
	select VIDEO_VS_SW_ISC
	help
	  This is a driver that is complying with Video for Linux 2 framework
	  for VeriSilicon's ISP series integrated processor. Basically, it
	  provides interfaces to configure hardware IP for VeriSilicon's camera
	  service and handles requests from user applications.

config VIDEO_VS_VSE_V4L
	tristate "VeriSilicon VSE (V4L) support"
	depends on VIDEO_DEV && OF && HAS_DMA
	select VIDEOBUF2_DMA_CONTIG
	select V4L2_FWNODE
	select VIDEO_V4L2_SUBDEV_API
	select VIDEO_VS_VID_V4L
	select VIDEO_VS_SW_ISC
	help
	  This is a driver that is complying with Video for Linux 2 framework
	  for VeriSilicon's VSE series integrated processor. Basically, it
	  provides interfaces to configure hardware IP for VeriSilicon's camera
	  service and handles requests from user applications.

config VIDEO_VS_SIF_V4L
	tristate "VeriSilicon SIF (V4L) support"
	depends on VIDEO_DEV && OF && HAS_DMA
	select VIDEOBUF2_DMA_CONTIG
	select V4L2_FWNODE
	select VIDEO_V4L2_SUBDEV_API
	select VIDEO_VS_CSI2_SNPS_V4L
	select VIDEO_VS_VID_V4L
	select VIDEO_VS_SW_ISC
	help
	  This is a driver that is complying with Video for Linux 2 framework
	  for VeriSilicon's SIF series integrated processor. Basically, it
	  provides interfaces to configure hardware IP for VeriSilicon's camera
	  service and handles requests from user applications.

config VIDEO_VS_CSI2_SNPS_V4L
	tristate "Synopsys CSI v2 (V4L) support"
	depends on VIDEO_DEV && OF
	select V4L2_FWNODE
	select VIDEO_V4L2_SUBDEV_API
	select VIDEO_VS_CSI_WRAPPER
	help
	  This is a driver that is complying with Video for Linux 2 framework
	  for Synopsys's MIPI CSI v2 integrated processor. It contains the key
	  configuration and executing logic for MIPI CSI v2 controller and
	  dphy in the hardware.

config VIDEO_VS_GDC_ARM_V4L
	tristate "ARM GDC (V4L) support"
	depends on VIDEO_DEV && OF && HAS_DMA
	select VIDEOBUF2_DMA_CONTIG
	select V4L2_FWNODE
	select VIDEO_V4L2_SUBDEV_API
	select VIDEO_VS_VID_V4L
	select VIDEO_VS_CAM_CTRL
	select VIDEO_VS_SW_ISC
	help
	  This is a driver that is complying with Video for Linux 2 framework
	  for ARM's GDC integrated processor. Basically, it provides interfaces
	  to configure hardware IP for VeriSilicon's camera service and handles
	  requests from user applications.

config VIDEO_VS_VID_V4L
	tristate "VeriSilicon Software Video (V4L) Support"
	depends on VIDEO_VS_ISP_V4L || VIDEO_VS_VSE_V4L || VIDEO_VS_SIF_V4L
	help
	  This is a software driver that is complying with Video for Linux 2
	  framework to create all required video devices and construct media
	  pipelines based on user requirements. It implements interfaces to
	  receive control commands and parameters from user applications and
	  deliver them to each camera IP module.

endif
endif
```
